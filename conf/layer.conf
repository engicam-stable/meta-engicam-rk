## conf/layer.conf
```bitbake
# We have a conf and classes directory, append to BBPATH
BBPATH .= ":${LAYERDIR}"

LAYERSERIES_COMPAT_engicam-rzg2 =" rocko "

# We have a recipes directory, add to BBFILES
BBFILES += "${LAYERDIR}/recipes-*/*/*.bb ${LAYERDIR}/recipes-*/*/*.bbappend"

BBFILE_COLLECTIONS += "engicam-rzg2"
BBFILE_PATTERN_engicam-rzg2 := "^${LAYERDIR}/"

# Define the priority for recipes (.bb files) from this layer,
# choosing carefully how this layer interacts with all of the
# other layers.

BBFILE_PRIORITY_engicam-rzg2 = "7"

LAYERDEPENDS_engicam-rzg2 = "rzg2"
```

## conf/machine/include/px30-core.conf
```bitbake
require conf/machine/include/px30.inc

UBOOT_MACHINE = "px30_defconfig"

RK_WIFIBT_FIRMWARES = ""

KBUILD_DEFCONFIG = "px30core_linux_defconfig"

SERIAL_CONSOLES = "115200;ttyS2"
```

## conf/machine/include/smarcore-rk3399.conf
```bitbake
require conf/machine/include/rk3399.inc

UBOOT_MACHINE = "smarcore_rk3399_defconfig"

RK_WIFIBT_FIRMWARES = ""

KBUILD_DEFCONFIG = "smarcorerk3399_linux_defconfig"

SERIAL_CONSOLES = "115200;ttyFIQ0"

MACHINE_EXTRA_RRECOMMENDS_append += " \
	linux-firmware-rk-cdndp \
"
```

## conf/machine/px30-core-ctouch2.conf
```bitbake
include include/px30-core.conf

KERNEL_DEVICETREE = "engicam/px30-core-ctouch2-linux.dtb"
```

## conf/machine/px30-core-evb2.conf
```bitbake
include include/px30-core.conf

KERNEL_DEVICETREE = "engicam/px30-core-evb2-linux.dtb"
```

## conf/machine/smarcore-rk3399-starterkit-dp.conf
```bitbake
include include/smarcore-rk3399.conf

KERNEL_DEVICETREE = "engicam/smarcore-rk3399-starterkit-linux-dp.dtb"
```
